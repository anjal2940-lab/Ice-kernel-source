## drivers/misc/mediatek/connectivity/Kconfig
```kconfig
config MTK_COMBO
	tristate "MediaTek Connectivity Combo Chip Support"
	select BT
	help
	  MTK connectivity combo chip driver for MT66xx
	  This config is used to turn on/off connsys

choice
	prompt "Select Chip"
	depends on MTK_COMBO
	help
	  This is used to select chip.
	  When MTK_COMBO is y, we need to choose a chip.

config MTK_COMBO_CHIP_MT6620
	bool "MT6620"

config MTK_COMBO_CHIP_MT6628
	bool "MT6628"

config MTK_COMBO_CHIP_MT7668
	bool "MT7668"

config MTK_COMBO_CHIP_MT6630
	bool "MT6630"

config MTK_COMBO_CHIP_MT6632
	bool "Mediatek MT6632 device driver support"

config MTK_COMBO_CHIP_CONSYS_6757
	bool "MTK MT6757 combo chip support"

config MTK_COMBO_CHIP_CONSYS_6763
	bool "MTK MT6763 combo chip support"

config MTK_COMBO_CHIP_CONSYS_6758
	bool "MTK MT6758 combo chip support"

config MTK_COMBO_CHIP_CONSYS_6759
	bool "MTK MT6759 combo chip support"

config MTK_COMBO_CHIP_CONSYS_6765
	bool "MTK MT6765 combo chip support (Redmi A1)"

config MTK_COMBO_CHIP_CONSYS_6761
	bool "MTK MT6761 combo chip support"

config MTK_COMBO_CHIP_CONSYS_8167
	bool "MTK MT8167 combo chip support"

config MTK_COMBO_CHIP_CONSYS_8168
	bool "MTK MT8168 combo chip support"

config MTK_COMBO_CHIP_CONSYS_3967
	bool "MTK MT3967 combo chip support"

config MTK_COMBO_CHIP_CONSYS_6771
	bool "MTK MT6771 combo chip support"

config MTK_COMBO_CHIP_CONSYS_6739
	bool "MTK MT6739 combo chip support"

config MTK_COMBO_CHIP_CONSYS_6768
	bool "MTK MT6768 combo chip support (Redmi 12C)"

config MTK_COMBO_CHIP_CONSYS_6779
	bool "MTK MT6779 combo chip support"

config MTK_COMBO_CHIP_CONSYS_6781
	bool "MTK MT6781 combo chip support"

config MTK_COMBO_CHIP_CONSYS_6785
	bool "MTK MT6785 combo chip support"

config MTK_COMBO_CHIP_CONSYS_6833
	bool "MTK MT6833 combo chip support"

config MTK_COMBO_CHIP_CONSYS_6853
	bool "MTK MT6853 combo chip support"

config MTK_COMBO_CHIP_CONSYS_6873
	bool "MTK MT6873 combo chip support"

config MTK_COMBO_CHIP_CONSYS_6877
	bool "MTK MT6877 combo chip support"

config MTK_COMBO_CHIP_CONSYS_6885
	bool "MTK MT6885 combo chip support"

config MTK_COMBO_CHIP_CONSYS_6893
	bool "MTK MT6893 combo chip support"

endchoice

config MTK_COMBO_CHIP
	string
	default "MT6620" if MTK_COMBO_CHIP_MT6620
	default "MT6628" if MTK_COMBO_CHIP_MT6628
	default "MT6630" if MTK_COMBO_CHIP_MT6630
	default "MT6632" if MTK_COMBO_CHIP_MT6632
	default "MT7668" if MTK_COMBO_CHIP_MT7668
	default "CONSYS_6757" if MTK_COMBO_CHIP_CONSYS_6757
	default "CONSYS_6763" if MTK_COMBO_CHIP_CONSYS_6763
	default "CONSYS_6758" if MTK_COMBO_CHIP_CONSYS_6758
	default "CONSYS_6759" if MTK_COMBO_CHIP_CONSYS_6759
	default "CONSYS_6765" if MTK_COMBO_CHIP_CONSYS_6765
	default "CONSYS_6761" if MTK_COMBO_CHIP_CONSYS_6761
	default "CONSYS_8167" if MTK_COMBO_CHIP_CONSYS_8167
	default "CONSYS_3967" if MTK_COMBO_CHIP_CONSYS_3967
	default "CONSYS_6771" if MTK_COMBO_CHIP_CONSYS_6771
	default "CONSYS_6739" if MTK_COMBO_CHIP_CONSYS_6739
	default "CONSYS_6768" if MTK_COMBO_CHIP_CONSYS_6768
	default "CONSYS_6779" if MTK_COMBO_CHIP_CONSYS_6779
	default "CONSYS_6781" if MTK_COMBO_CHIP_CONSYS_6781
	default "CONSYS_6785" if MTK_COMBO_CHIP_CONSYS_6785
	default "CONSYS_6833" if MTK_COMBO_CHIP_CONSYS_6833
	default "CONSYS_6853" if MTK_COMBO_CHIP_CONSYS_6853
	default "CONSYS_6873" if MTK_COMBO_CHIP_CONSYS_6873
	default "CONSYS_6885" if MTK_COMBO_CHIP_CONSYS_6885
	default "CONSYS_6893" if MTK_COMBO_CHIP_CONSYS_6893
	default "CONSYS_6877" if MTK_COMBO_CHIP_CONSYS_6877

config MTK_COMBO_PLAT_PATH
	string "Platform folder name"
	depends on MTK_COMBO
	default "sample"

config MTK_COMBO_COMM
	depends on MTK_COMBO
	tristate "MediaTek Combo Chip Common part driver"

config MTK_COMBO_COMM_UART
	depends on MTK_COMBO_COMM
	tristate "Common interface UART"

config MTK_COMBO_COMM_SDIO
	depends on MTK_COMBO_COMM
	tristate "Common interface SDIO"

config MTK_COMBO_COMM_NPWR
	depends on MTK_COMBO_COMM
	bool "Enable NPWR support"
	default n

config MTK_COMBO_COMM_APO
	depends on MTK_COMBO_COMM
	bool "Enable always power on support"
	default n

config MTK_COMBO_BT
	tristate "MediaTek Combo Chip BT driver"
	depends on MTK_COMBO

config MTK_COMBO_ANT
	tristate "MediaTek Combo Chip ANT driver"
	depends on MTK_COMBO

config MTK_COMBO_BT_HCI
	tristate "MediaTek Combo Chip BlueZ driver"
	depends on BT && MTK_COMBO

config MTK_COMBO_GPS
	tristate "MediaTek Combo Chip GPS driver"
	depends on MTK_COMBO

config MTK_COMBO_WIFI
	tristate "MediaTek combo chip Wi-Fi support"
	depends on MTK_COMBO
	select WIRELESS_EXT
	select WEXT_PRIV

config MTK_PASSPOINT_R1_SUPPORT
	bool "MTK_PASSPOINT_R1_SUPPORT"
	depends on MTK_COMBO_WIFI

config MTK_PASSPOINT_R2_SUPPORT
	bool "MTK_PASSPOINT_R2_SUPPORT"
	depends on MTK_COMBO_WIFI

config MTK_WIFI_MCC_SUPPORT
	bool "MTK_WIFI_MCC_SUPPORT"
	depends on MTK_COMBO_WIFI
	default y

config MTK_DHCPV6C_WIFI
	bool "MTK_DHCPV6C_WIFI"

config MTK_CONN_LTE_IDC_SUPPORT
	bool "MediaTek CONN LTE IDC support"
	default y if MTK_ECCCI_DRIVER

menuconfig GPS
	tristate "GPS drivers"
	default n

config MTK_GPS_SUPPORT
	tristate "support MediaTek GPS driver"

config MTK_GPS_REGISTER_SETTING
	tristate "MediaTek GPS Register Setting"
	depends on MTK_COMBO_GPS

config MTK_GPS_EMI
	tristate "MediaTek GPS EMI Driver"
	depends on MTK_COMBO_GPS

config MTK_FMRADIO
	tristate "MediaTek FMRadio driver"
	depends on MTK_COMBO

config MTK_FM_CHIP
	string "MTK FM CHIP"
	depends on MTK_FMRADIO

config MTK_FM_50KHZ_SUPPORT
	bool "support MTK FM 50KHZ"
	depends on MTK_FMRADIO

config MTK_MERGE_INTERFACE_SUPPORT
	bool "support MTK MERGE INTERFACE"

config MTK_COMBO_CHIP_DEEP_SLEEP_SUPPORT
	depends on MTK_COMBO_CHIP_MT6632
	default y
	tristate "Mediatek combo chip deep sleep feature setting"

config MTK_CONN_MT3337_CHIP_SUPPORT
	bool "Mediatek MT3337 device driver support"

config MTK_CONNSYS_DEDICATED_LOG_PATH
	bool "Enable connsys log using dedicated path"
	default n

config WLAN_DRV_BUILD_IN
	bool "Build Wlan module in kernel"
	depends on MTK_COMBO
	default y

config MTK_EXTRA_CONN_DRV_BUILD_IN
	bool "Build connectivity module in kernel"
	depends on MTK_COMBO
	default y
```
